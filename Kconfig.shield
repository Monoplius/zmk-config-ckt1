## Kconfig.shield
```kconfig
config SHIELD_CKV1_LEFT
    def_bool $(shields_list_contains,ckv1_left)

config SHIELD_CKV1_RIGHT
    def_bool $(shields_list_contains,ckv1_right)
```

## boards/shields/ckv1/Kconfig.defconfig
```kconfig
if SHIELD_CKV1_LEFT

config ZMK_KEYBOARD_NAME
    default "CKV1"

config ZMK_SPLIT_ROLE_CENTRAL
    default y

config ZMK_STUDIO
    default y

endif

if SHIELD_CKV1_LEFT || SHIELD_CKV1_RIGHT

config ZMK_SPLIT
    default y

endif
```
