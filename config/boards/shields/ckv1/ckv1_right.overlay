#include "ckv1.dtsi"

&kscan0 {
    // Left half columns (adjust pins!)
    col-gpios 
  = <&pro_micro16 GPIO_ACTIVE_HIGH  // Bottom (P0.10)
  , <&pro_micro10 GPIO_ACTIVE_HIGH   // Home (P0.09)
  , <&pro_micro9  GPIO_ACTIVE_HIGH   // Top (P1.06)
  , <&pro_micro8  GPIO_ACTIVE_HIGH   // Num (P1.04)
  , <&pro_micro21 GPIO_ACTIVE_HIGH  // Cluster (P0.31)
  , <&pro_micro20 GPIO_ACTIVE_HIGH  // Fn (P0.29)
      >;
};
