#include <dt-bindings/zmk/matrix_transform.h>

/ {
  chosen {
    zmk,matrix_transform = &default_transform;
    zmk,kscan = &kscan0;
  };

  default_transform: keymap_transform_0 {
    compatible = "zmk,matrix-transform";
    rows = <6>;
    columns = <8>;
    map = <
      // Left Half (Main + Thumbs)
      RC(0,0) RC(0,1) RC(0,2) RC(0,3) RC(0,4) RC(0,5)
      RC(1,0) RC(1,1) RC(1,2) RC(1,3) RC(1,4) RC(1,5)
      RC(2,0) RC(2,1) RC(2,2) RC(2,3) RC(2,4) RC(2,5)
      RC(3,0) RC(3,1) RC(3,2) RC(3,3) RC(3,4) RC(3,5)
      RC(4,6) RC(4,7)
      RC(5,6)

      // Right Half (Mirror GPIOs)
      RC(0,0) RC(0,1) RC(0,2) RC(0,3) RC(0,4) RC(0,5)
      RC(1,0) RC(1,1) RC(1,2) RC(1,3) RC(1,4) RC(1,5)
      RC(2,0) RC(2,1) RC(2,2) RC(2,3) RC(2,4) RC(2,5)
      RC(3,0) RC(3,1) RC(3,2) RC(3,3) RC(3,4) RC(3,5)
      RC(4,6) RC(4,7)
      RC(5,6)
    >;
  };

  kscan0: kscan {
    compatible = "zmk,kscan-gpio-matrix";
    diode-direction = "col2row";

    #ifdef SIDE_LEFT
      col-gpios = <
        &gpio7 GPIO_ACTIVE_HIGH  // Outer (P0.11)
        &gpio6 GPIO_ACTIVE_HIGH   // Pinky (P1.00)
        &gpio5 GPIO_ACTIVE_HIGH  // Ring (P0.24)
        &gpio4 GPIO_ACTIVE_HIGH  // Middle (P0.22)
        &gpio3 GPIO_ACTIVE_HIGH  // Index (P0.20)
        &gpio2 GPIO_ACTIVE_HIGH  // Inner (P0.17)
        &gpio1 GPIO_ACTIVE_HIGH   // Thumb Layer (P0.08)
        &gpio0 6 GPIO_ACTIVE_HIGH   // Thumb Space (P0.06)
      >;
      row-gpios = <
        &gpio16 GPIO_ACTIVE_HIGH  // Bottom (P0.10)
        &gpio10 GPIO_ACTIVE_HIGH   // Home (P0.09)
        &gpio9  GPIO_ACTIVE_HIGH   // Top (P1.06)
        &gpio8  GPIO_ACTIVE_HIGH   // Num (P1.04)
        &gpio21 GPIO_ACTIVE_HIGH  // Cluster (P0.31)
        &gpio20 GPIO_ACTIVE_HIGH  // Fn (P0.29)
      >;
    #endif

    #ifdef SIDE_RIGHT
      col-gpios = <
        &gpio7 GPIO_ACTIVE_HIGH  // Outer (P0.11)
        &gpio6 GPIO_ACTIVE_HIGH   // Pinky (P1.00)
        &gpio5 GPIO_ACTIVE_HIGH  // Ring (P0.24)
        &gpio4 GPIO_ACTIVE_HIGH  // Middle (P0.22)
        &gpio3 GPIO_ACTIVE_HIGH  // Index (P0.20)
        &gpio2 GPIO_ACTIVE_HIGH  // Inner (P0.17)
        &gpio1 GPIO_ACTIVE_HIGH   // Thumb Layer (P0.08)
        &gpio0 GPIO_ACTIVE_HIGH   // Thumb Space (P0.06)
      >;
      row-gpios = <
        &gpio16 GPIO_ACTIVE_HIGH  // Bottom (P0.10)
        &gpio10 GPIO_ACTIVE_HIGH   // Home (P0.09)
        &gpio9  GPIO_ACTIVE_HIGH   // Top (P1.06)
        &gpio8  GPIO_ACTIVE_HIGH   // Num (P1.04)
        &gpio21 GPIO_ACTIVE_HIGH  // Cluster (P0.31)
        &gpio20 GPIO_ACTIVE_HIGH  // Fn (P0.29)
      >;
    #endif
  };
};
